## CMakeLists.txt
```
cmake_minimum_required(VERSION 3.13.1)

# board, dts, soc
set(BOARD_ROOT ${CMAKE_CURRENT_LIST_DIR})
set(DTS_ROOT ${CMAKE_CURRENT_LIST_DIR}/dts)

# evm path
set(EVM_BASE ${ZEPHYR_BASE}/../../../)

include_directories(app PRIVATE src)

# heatshrink module
list(APPEND ZEPHYR_EXTRA_MODULES
    ${EVM_BASE}/modules/heatshrink
)

# evm module
list(APPEND ZEPHYR_EXTRA_MODULES
    ${EVM_BASE}/modules/evm
)

# ecma
list(APPEND ZEPHYR_EXTRA_MODULES
    ${EVM_BASE}/modules/ecma
)

# driver
list(APPEND ZEPHYR_EXTRA_MODULES
    ${EVM_BASE}/drivers
)

find_package(Zephyr HINTS $ENV{ZEPHYR_BASE})
project(evm)

if(CONFIG_EVM_LANG_JAVASCRIPT)
    set(LIBEVM ${EVM_BASE}/lib/arm-none-eabi-gcc/cortex-m3/libejs.a)
elseif(CONFIG_EVM_LANG_PYTHON)
    set(LIBEVM ${EVM_BASE}/lib/arm-none-eabi-gcc/cortex-m3/libepy.a)
elseif(CONFIG_EVM_LANG_QML)
    set(LIBEVM ${EVM_BASE}/lib/arm-none-eabi-gcc/cortex-m3/libeqml.a)   
else()
    set(LIBEVM ${EVM_BASE}/lib/arm-none-eabi-gcc/cortex-m3/libejs.a)
endif()

message(${LIBEVM})
target_link_libraries(app PRIVATE ${LIBEVM})

include_directories(app PRIVATE ${EVM_BASE}/include)
include_directories(app PRIVATE ${EVM_BASE}/bsp/common)

target_sources(app PRIVATE src/main.c)
target_sources(app PRIVATE ${EVM_BASE}/bsp/common/evm_main.c)
target_sources(app PRIVATE ${EVM_BASE}/bsp/common/uol_output.c)
```

## prj.conf
```kconfig
CONFIG_NEWLIB_LIBC=y
CONFIG_STDOUT_CONSOLE=y
CONFIG_CONSOLE_SUBSYS=y
CONFIG_CONSOLE_GETCHAR=y
CONFIG_STDOUT_CONSOLE=y
CONFIG_PRINTK=y
CONFIG_MAIN_STACK_SIZE=4096
CONFIG_EVM_HEATSHRINK=y
```

## src/main.c
```c
/****************************************************************************
**
** Copyright (C) 2020 @scriptiot
**
**  EVM是一款通用化设计的虚拟机引擎，拥有语法解析前端接口、编译器、虚拟机和虚拟机扩展接口框架。
**  支持js、python、qml、lua等多种脚本语言，纯Ｃ开发，零依赖，内置REPL，支持主流 ROM > 40KB, RAM > 2KB的MCU;
**  自带垃圾回收（GC）先进的内存管理，采用最复杂的压缩算法，无内存碎片（大部分解释器都存在内存碎片）
**  Version	: 1.0
**  Email	: scriptiot@aliyun.com
**  Website	: https://github.com/scriptiot/evm
**            https://gitee.com/scriptiot/evm
**  Licence: Apache-2.0
****************************************************************************/

#include "evm_main.h"

void main(void)
{
    evm_main();
}
```
