## CMakeLists.txt
```
# SPDX-License-Identifier: Apache-2.0

cmake_minimum_required(VERSION 3.13.1)

set(BOARD_ROOT ${CMAKE_CURRENT_LIST_DIR})
set(DTS_ROOT ${CMAKE_CURRENT_LIST_DIR}/dts)

set(BOARD stm32f103_fire_arbitrary)

set(EVM_BASE ${ZEPHYR_BASE}/../../../)

list(APPEND ZEPHYR_EXTRA_MODULES
    ${EVM_BASE}/modules/heatshrink
)

find_package(Zephyr HINTS $ENV{ZEPHYR_BASE})
project(ejs)

set(LIBEJS ${EVM_BASE}/lib/arm-none-eabi-gcc/cortex-m3/libejs.a)
message(${LIBEJS})
target_link_libraries(app PRIVATE ${LIBEJS})

set(evm_ecma_sources 
    ${EVM_BASE}/modules/ecma/ecma.c
    ${EVM_BASE}/modules/ecma/ecma_object.c
    ${EVM_BASE}/modules/ecma/ecma_array.c
    ${EVM_BASE}/modules/ecma/ecma_math.c
    ${EVM_BASE}/modules/ecma/ecma_regexp.c
    ${EVM_BASE}/modules/ecma/ecma_number.c
    ${EVM_BASE}/modules/ecma/ecma_string.c
    ${EVM_BASE}/modules/ecma/re.c
)
set(evm_driver_sources 
    ${EVM_BASE}/drivers/zephyr/uol/adc_driver.c 
    ${EVM_BASE}/drivers/zephyr/uol/can_driver.c 
    ${EVM_BASE}/drivers/zephyr/uol/dac_driver.c
    ${EVM_BASE}/drivers/zephyr/uol/flash_driver.c
    ${EVM_BASE}/drivers/zephyr/uol/gpio_driver.c
    ${EVM_BASE}/drivers/zephyr/uol/i2c_driver.c
    ${EVM_BASE}/drivers/zephyr/uol/rtc_driver.c
    ${EVM_BASE}/drivers/zephyr/uol/spi_driver.c
    ${EVM_BASE}/drivers/zephyr/uol/timer_driver.c
    ${EVM_BASE}/drivers/zephyr/uol/uart_driver.c
    ${EVM_BASE}/drivers/zephyr/uol/watchdog_driver.c
    ${EVM_BASE}/drivers/zephyr/uol/pwm_driver.c
    ${EVM_BASE}/drivers/zephyr/uol/sys_driver.c
)

set(evm_modules_sources 
    ${EVM_BASE}/modules/evm/evm_module.c 
    ${EVM_BASE}/modules/evm/evm_module_adc.c 
    ${EVM_BASE}/modules/evm/evm_module_can.c
    ${EVM_BASE}/modules/evm/evm_module_dac.c
    ${EVM_BASE}/modules/evm/evm_module_flash.c
    ${EVM_BASE}/modules/evm/evm_module_i2c.c
    ${EVM_BASE}/modules/evm/evm_module_lcd.c
    ${EVM_BASE}/modules/evm/evm_module_led.c
    ${EVM_BASE}/modules/evm/evm_module_pin.c
    ${EVM_BASE}/modules/evm/evm_module_rtc.c
    ${EVM_BASE}/modules/evm/evm_module_spi.c
    ${EVM_BASE}/modules/evm/evm_module_switch.c
    ${EVM_BASE}/modules/evm/evm_module_timer.c
    ${EVM_BASE}/modules/evm/evm_module_uart.c
    ${EVM_BASE}/modules/evm/evm_module_watchdog.c
    ${EVM_BASE}/modules/evm/evm_module_led.c
    ${EVM_BASE}/modules/evm/evm_module_wifi.c
    ${EVM_BASE}/modules/evm/evm_module_network.c
    ${EVM_BASE}/modules/evm/evm_module_socket.c

)

if(CONFIG_EVM_W5500)
include_directories(app PRIVATE ${EVM_BASE}/drivers/zephyr/ethernet)
include_directories(app PRIVATE ${EVM_BASE}/drivers/zephyr/ethernet/w5500/ioLibrary/Ethernet)
set(evm_driver_w5500_src
    ${EVM_BASE}/drivers/zephyr/ethernet/w5500/ioLibrary/Ethernet/wizchip_conf.c
    ${EVM_BASE}/drivers/zephyr/ethernet/w5500/ioLibrary/Ethernet/W5500/w5500.c
    ${EVM_BASE}/drivers/zephyr/ethernet/w5500/driver_w5500.c
)
endif()

set(libevm_module_sources 
    ${evm_driver_sources}
    ${evm_modules_sources}
    ${evm_ecma_sources}
    ${evm_driver_w5500_src}
)

include_directories(app PRIVATE ${EVM_BASE}/include)
include_directories(app PRIVATE ${EVM_BASE}/bsp/common)
include_directories(app PRIVATE ${EVM_BASE}/modules/ecma)
include_directories(app PRIVATE ${EVM_BASE}/modules/evm)


include_directories(app PRIVATE src)

target_sources(app PRIVATE ${libevm_module_sources})
target_sources(app PRIVATE src/main.c)
target_sources(app PRIVATE ${EVM_BASE}/bsp/common/evm_main.c)
target_sources(app PRIVATE src/evm_board.c)
target_sources(app PRIVATE ${EVM_BASE}/bsp/common/uol_output.c)

# evm module config
add_definitions("-DCONFIG_EVM_TIMER")
add_definitions("-DCONFIG_EVM_NETWORK")

# ecma module config
add_definitions("-DCONFIG_EVM_ECMA_OBJECT")
add_definitions("-DCONFIG_EVM_ECMA_ARRAY")

# language config 
add_definitions("-DCONFIG_EVM_LANG_JS")
```

## prj.conf
```kconfig
# libc config
CONFIG_NEWLIB_LIBC=y

# console config
CONFIG_STDOUT_CONSOLE=y
CONFIG_CONSOLE_SUBSYS=y
CONFIG_CONSOLE_GETCHAR=y
CONFIG_PRINTK=y

# zephyr config
CONFIG_MAIN_STACK_SIZE=4096

# driver config
CONFIG_GPIO=y
CONFIG_FLASH=y
CONFIG_SPI=y

# # Networking config
CONFIG_NETWORKING=y
CONFIG_NET_IPV4=y
# CONFIG_NET_IPV6=n
# CONFIG_NET_TCP=y
# CONFIG_NET_SOCKETS=y
# CONFIG_NET_SOCKETS_POSIX_NAMES=y

# # Network driver config
CONFIG_TEST_RANDOM_GENERATOR=y

# # Network address config
# CONFIG_NET_CONFIG_SETTINGS=y
# CONFIG_NET_CONFIG_NEED_IPV4=y
# CONFIG_NET_L2_ETHERNET=y

# CONFIG_LOG=y
# CONFIG_NET_LOG=y
# CONFIG_NET_MGMT=y
# CONFIG_NET_MGMT_EVENT=y
# CONFIG_ETHERNET_LOG_LEVEL_DBG=y

# CONFIG_NET_TX_STACK_SIZE=2048
# CONFIG_NET_RX_STACK_SIZE=2048

# CONFIG_NET_PKT_RX_COUNT=10
# CONFIG_NET_PKT_TX_COUNT=10
# CONFIG_NET_BUF_RX_COUNT=20
# CONFIG_NET_BUF_TX_COUNT=20
# CONFIG_NET_MAX_CONTEXTS=10

# DHCP config
# CONFIG_NET_ARP=y
# CONFIG_NET_UDP=y
# CONFIG_NET_DHCPV4=y
```

## src/main.c
```c
/****************************************************************************
**
** Copyright (C) 2020 @scriptiot
**
**  EVM是一款通用化设计的虚拟机引擎，拥有语法解析前端接口、编译器、虚拟机和虚拟机扩展接口框架。
**  支持js、python、qml、lua等多种脚本语言，纯Ｃ开发，零依赖，内置REPL，支持主流 ROM > 40KB, RAM > 2KB的MCU;
**  自带垃圾回收（GC）先进的内存管理，采用最复杂的压缩算法，无内存碎片（大部分解释器都存在内存碎片）
**  Version	: 1.0
**  Email	: scriptiot@aliyun.com
**  Website	: https://github.com/scriptiot/evm
**            https://gitee.com/scriptiot/evm
**  Licence: Apache-2.0
****************************************************************************/

#include "evm_main.h"

#include <device.h>
#include <drivers/uart.h>
#include <zephyr.h>

void main(void)
{
    evm_main();
}
```

## src/evm_board.c
```c
/****************************************************************************
**
** Copyright (C) 2020 @scriptiot
**
**  EVM是一款通用化设计的虚拟机引擎，拥有语法解析前端接口、编译器、虚拟机和虚拟机扩展接口框架。
**  支持js、python、qml、lua等多种脚本语言，纯Ｃ开发，零依赖，内置REPL，支持主流 ROM > 40KB, RAM > 2KB的MCU;
**  自带垃圾回收（GC）先进的内存管理，采用最复杂的压缩算法，无内存碎片（大部分解释器都存在内存碎片）
**  Version	: 1.0
**  Email	: scriptiot@aliyun.com
**  Website	: https://github.com/scriptiot/evm
**            https://gitee.com/scriptiot/evm
**  Licence: Apache-2.0
****************************************************************************/

#include "evm_board.h"

const struct pin_group ledgroup[] = {
    {"GPIOC", 13, GPIO_OUTPUT},
    {NULL, 0, 0},
};

const struct pin_group keygroup[] = {
    {"GPIOB", 2, GPIO_INPUT | GPIO_INT_ENABLE | GPIO_INT_EDGE | GPIO_INT_LOW_0 | GPIO_PULL_UP},
    {"GPIOB", 3, GPIO_INPUT | GPIO_INT_ENABLE | GPIO_INT_EDGE | GPIO_INT_LOW_0 | GPIO_PULL_UP},
    {NULL, 0, 0},
};

int evm_board_get_pin_group_size(const pin_group * group){
    int i = 0;
    while( group[i].port != NULL ){
        i++;
    }
    return i;
}
```
