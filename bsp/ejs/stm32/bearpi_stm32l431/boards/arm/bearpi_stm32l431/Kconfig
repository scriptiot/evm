## bsp/ejs/stm32/bearpi_stm32l431/boards/arm/bearpi_stm32l431/Kconfig
```kconfig
config ETH_W5500_RX_THREAD_STACK_SIZE
    int
	default 800

config ETH_W5500_RX_THREAD_PRIO
    int
	default 2

config ETH_W5500_TIMEOUT
    int
	default 100
```

## bsp/ejs/stm32/stm32f103-fire-arbitrary/soc/arm/st_stm32/stm32l4/Kconfig.defconfig.stm32l431xx
```kconfig
# ST Microelectronics STM32L431XX MCU

# Copyright (c) 2016 Open-RnD Sp. z o.o.
# Copyright (c) 2016 BayLibre, SAS
# SPDX-License-Identifier: Apache-2.0

if SOC_STM32L431XX

config SOC
	default "stm32l431xx"

config NUM_IRQS
	default 83

endif # SOC_STM32L431XX
```

## bsp/stm32/bearpi_stm32L431/boards/arm/bearpi_stm32l431/Kconfig.board
```kconfig
config BOARD_BEARPI_STM32L431RC
	bool "Bearpi STM32L431RC Development Board"
	depends on SOC_STM32L431XX
```

## bsp/stm32/bearpi_stm32l431/boards/arm/bearpi_stm32l431/Kconfig.board
```kconfig
config BOARD_BEARPI_STM32L431
	bool "Bearpi STM32L431 Development Board"
	depends on SOC_STM32L431XX
```

## bsp/stm32/bearpi_stm32l431/boards/arm/bearpi_stm32l431/Kconfig.defconfig
```kconfig
# STM32L432KC Nucleo board configuration

# Copyright (c) 2016 Open-RnD Sp. z o.o.
# Copyright (c) 2016 BayLibre, SAS
# SPDX-License-Identifier: Apache-2.0

if BOARD_BEARPI_STM32L431

config BOARD
	default "bearpi_stm32l431"

config SPI_STM32_INTERRUPT
	default y
	depends on SPI

config ST7789V
	default y
	depends on DISPLAY


endif
```

## bsp/zephyr/stm32/bearpi_stm32l431/boards/arm/bearpi_stm32l431/Kconfig
```kconfig
config ETH_W5500
    bool "Enable wiznet w5500 ethernet controller"
	default n

config ETH_W5500_RX_THREAD_STACK_SIZE
    int
	default 800

config ETH_W5500_RX_THREAD_PRIO
    int
	default 2

config ETH_W5500_TIMEOUT
    int
	default 100
```

## bsp/zephyr/stm32/bearpi_stm32l431/boards/arm/bearpi_stm32l431/Kconfig.board
```kconfig
# STM32L432KC Nucleo board configuration

# Copyright (c) 2016 Open-RnD Sp. z o.o.
# Copyright (c) 2016 BayLibre, SAS
# SPDX-License-Identifier: Apache-2.0

config BOARD_BEARPI_STM32L431
	bool "bearpi stm32l431 Development Board"
	depends on SOC_STM32L432XX
```

## bsp/zephyr/stm32/bearpi_stm32l431/boards/arm/bearpi_stm32l431/Kconfig.defconfig
```kconfig
# STM32L432KC Nucleo board configuration

# Copyright (c) 2016 Open-RnD Sp. z o.o.
# Copyright (c) 2016 BayLibre, SAS
# SPDX-License-Identifier: Apache-2.0

if BOARD_BEARPI_STM32L431

config BOARD
	default "bearpi_stm32l431"

config ST7789V
	default y
	depends on DISPLAY

config HAS_STM32CUBE
	default y

config USE_STM32_HAL_MMC
	default y

config USE_STM32_HAL_MMC_EX
	default y

config USE_STM32_HAL_SD
	default y

config USE_STM32_LL_SDMMC
	default y




endif
```

## bsp/zephyr/stm32/stm32f103-fire-arbitrary/boards/arm/stm32f103_fire_arbitrary/Kconfig.board
```kconfig
# NUCLEO-64 F103RB board configuration

# Copyright (c) 2016 Open-RnD Sp. z o.o.
# SPDX-License-Identifier: Apache-2.0

config STM32F103_FIRE_ARBITRARY
	bool "stm32f103 fire arbitrary Development Board"
	depends on SOC_STM32F103XE
```

## bsp/zephyr/stm32/stm32f103-fire-arbitrary/boards/arm/stm32f103_fire_arbitrary/Kconfig.defconfig
```kconfig
# NUCLEO-64 F103RB board configuration

# Copyright (c) 2016 Open-RnD Sp. z o.o.
# SPDX-License-Identifier: Apache-2.0

if STM32F103_FIRE_ARBITRARY

config BOARD
	default "stm32f103_fire_arbitrary"


endif
```

## bsp/zephyr/stm32/stm32f103-fire-arbitrary/boards/arm/stm32f103_fire_arbitrary/stm32f103_fire_arbitrary_defconfig
```kconfig
# SPDX-License-Identifier: Apache-2.0

CONFIG_SOC_SERIES_STM32F1X=y
CONFIG_SOC_STM32F103XE=y
# 72MHz system clock
CONFIG_SYS_CLOCK_HW_CYCLES_PER_SEC=72000000

# enable uart driver
CONFIG_SERIAL=y
# enable console
CONFIG_CONSOLE=y
CONFIG_UART_CONSOLE=y

# enable pinmux
CONFIG_PINMUX=y

# enable GPIO
CONFIG_GPIO=y

# Clock configuration
CONFIG_CLOCK_CONTROL=y
# SYSCLK selection
CONFIG_CLOCK_STM32_SYSCLK_SRC_PLL=y
# HSE configuration
CONFIG_CLOCK_STM32_HSE_CLOCK=8000000
# PLL configuration
CONFIG_CLOCK_STM32_PLL_SRC_HSE=y
# produce 48MHz clock at PLL output
CONFIG_CLOCK_STM32_PLL_PREDIV=1
CONFIG_CLOCK_STM32_PLL_MULTIPLIER=9
CONFIG_CLOCK_STM32_AHB_PRESCALER=1
CONFIG_CLOCK_STM32_APB1_PRESCALER=1
```

## drivers/zephyr/Kconfig
```kconfig
menu "Extra Device Drivers"

menu "Ethernet W5500"
    menuconfig ETH_W5500
        bool "W5500 Ethernet Controller"
        depends on SPI
        help
        W5500 Stand-Alone Ethernet Controller
        with SPI Interface

    config ETH_W5500_RX_THREAD_STACK_SIZE
        int "Receiving thread stack size"
        default 800

    config ETH_W5500_RX_THREAD_PRIO
        int "Receiving thread priority"
        default 2

    config ETH_W5500_TIMEOUT
        int "W5500 ethernet timeout"
        default 100

    config ETH_W5500_TX_BUF_SIZE
        int "Transmitting buffer size"
        default 2

    config ETH_W5500_RX_BUF_SIZE
        int "Receiving buffer size"
        default 2
endmenu

menu "Display ili9341"
    menuconfig STM32_DISPLAY_ILI9341
        bool "Enable stm32 display driver ili9341 in fsmc mode"
        default n
endmenu

endmenu
```

## modules/ecma/zephyr/Kconfig
```kconfig
menu "EVM ECMA module"
config EVM_ECMA
    bool "Enable EVM ecma module"
	default n

config EVM_ECMA_ARRAY
    bool "Enable EVM ecma array"
	default n

config EVM_ECMA_MATH
    bool "Enable EVM ecma math"
	default n

config EVM_ECMA_NUMBER
    bool "Enable EVM ecma number"
	default n

config EVM_ECMA_OBJECT
    bool "Enable EVM ecma object"
	default n

config EVM_ECMA_REGEXP
    bool "Enable EVM ecma regular expression"
	default n
config EVM_ECMA_STRING
    bool "Enable EVM ecma string"
	default n
endmenu
```

## modules/evm/zephyr/Kconfig
```kconfig
menu "EVM Modules"
config EVM_MODULE
    bool "Enable EVM module"
	default n

config EVM_MODULE_CAN
    bool "Enable EVM can module"
	default n

config EVM_MODULE_DAC
    bool "Enable EVM dac module"
	default n

config EVM_MODULE_FLASH
    bool "Enable EVM flash module"
	default n

config EVM_MODULE_I2C
    bool "Enable EVM i2c module"
	default n

config EVM_MODULE_LCD
    bool "Enable EVM lcd module"
	default n

config EVM_MODULE_LED
    bool "Enable EVM led module"
	default n

config EVM_MODULE_MODBUS_RTU_MASTER
    bool "Enable EVM modbus rtu master module"
	default n

config EVM_MODULE_NETWORK
    bool "Enable EVM network module"
	default n

config EVM_MODULE_PIN
    bool "Enable EVM pin module"
	default n

config EVM_MODULE_RTC
    bool "Enable EVM rtc module"
	default n

config EVM_MODULE_SOCKET
    bool "Enable EVM socket module"
	default n

config EVM_MODULE_SWITCH
    bool "Enable EVM switch button module"
	default n

config EVM_MODULE_TIMER
    bool "Enable EVM timer module"
	default n

config EVM_MODULE_UART
    bool "Enable EVM uart module"
	default n

config EVM_MODULE_WATCHDOG
    bool "Enable EVM watchdog module"
	default n

config EVM_MODULE_WIFI
    bool "Enable EVM wifi module"
	default n
endmenu
```
